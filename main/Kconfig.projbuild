## main/Kconfig.projbuild
```kconfig
menu "ESPDrone Config"

    choice
        prompt "ESP_Drone hardware version"
        default TARGET_ESP32_S2_DRONE_V1_2 if IDF_TARGET_ESP32S3
        default TARGET_ESP32_S2_DRONE_V1_2 if IDF_TARGET_ESP32S2
        default TARGET_ESPLANE_V1 if IDF_TARGET_ESP32

        config TARGET_ESPLANE_V1
            bool "esplane with esp32 onboard(old version )"

        config TARGET_ESPLANE_V2_S2
            bool "esplane with esp32-s2 onboard"

        config TARGET_ESP32_S2_DRONE_V1_2
            bool "esp-drone with ESP32-S2/ESP32-S3 onboard"

    endchoice

    choice
        prompt "extend board version"
        default EXT_AUTO_DETECT
        config EXT_FLOW_TESTBOARD
            bool "use testboard 200616"
            help
                This board use wrong pin definition,only for test.
        config EXT_AUTO_DETECT
            bool "auto detect"
            help
                enable this to use extend board.
    endchoice

    menu "app set"
        config ENABLE_LEGACY_APP
            bool "Enable legacy ESPlane1.0 APP"
            default n
            help
                This enables the udp_server_rx2_task of wifi.
        config ENABLE_POSITION_HOLD_MODE
            bool "Enable position hold mode"
            default y
            help
                This enables position hold mode when pmw3901 sensors available.
        config ENABLE_COMMAND_MODE_SET
            bool "Enable \'setCommandermode\' to transform command"
            depends on ENABLE_POSITION_HOLD_MODE
            default y if ENABLE_POSITION_HOLD_MODE
            default n if !ENABLE_POSITION_HOLD_MODE
            help
                This enables assit mode when use old version app.
    endmenu

    menu "wireless config"
        config WIFI_BASE_SSID
            string "Wi-Fi Base SSID"
            default "ESP-DRONE"
            help
                Wi-Fi Base SSID, 1-16 characters. the final SSID will be BASE_SSID-MAC
        config WIFI_PASSWORD
            string "Wi-Fi Password"
            default "12345678"
            help
                Wi-Fi Password, 8-64 characters
        config WIFI_CHANNEL
            int "Wi-Fi/ESP-Now Channel"
            range 1 13
            default 6
            help
                Wi-Fi/ESP-Now Channel, 1-13
        config WIFI_MAX_STA_CONN
            int "Wi-Fi Max Station Connection"
            range 1 6
            default 3
            help
                Wi-Fi Max Station Connection, 1-6
    endmenu

    menu "calibration angle"
        config PITCH_CALIB
            int "PITCH_CALIB deg*100"
            range -200 200
            default 0
            help
                if PITCH error angle is 0.90,set this 90

        config ROLL_CALIB
            int "ROLL_CALIB deg*100"
            range -200 200
            default 0
            help
                if ROLL error angle is 0.90,set this 90
    endmenu

    menu "system"

        config BASE_STACK_SIZE
            int "base stack size for system task"
            range 512 1024
            default 1024 if IDF_TARGET_ESP32
            default 512 if IDF_TARGET_ESP32S2
            default 1024 if IDF_TARGET_ESP32S3

    endmenu

endmenu
```
